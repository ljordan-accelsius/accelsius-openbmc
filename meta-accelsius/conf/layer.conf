## meta-accelsius/conf/layer.conf
```bitbake
# We have a conf and classes directory, add to BBPATH
BBPATH .= ":${LAYERDIR}"

# We have recipes-* directories, add to BBFILES
BBFILES += "${LAYERDIR}/recipes-*/*/*.bb \
            ${LAYERDIR}/recipes-*/*/*.bbappend"

BBFILE_COLLECTIONS += "accelsius-layer"
BBFILE_PATTERN_accelsius-layer := "^${LAYERDIR}/"
LAYERSERIES_COMPAT_accelsius-layer = "kirkstone langdale"
```

## meta-accelsius/conf/machine/include/accelsius.inc
```bitbake
DISTROOVERRIDES .= ":accelsius"

MACHINE_FEATURES += "\
        obmc-bmc-state-mgmt \
        obmc-phosphor-fan-mgmt \
        obmc-phosphor-flash-mgmt \
        "

VIRTUAL-RUNTIME_skeleton_workbook = "${MACHINE}-config"

PREFERRED_PROVIDER_virtual/obmc-chassis-mgmt = "packagegroup-accelsius-apps"
PREFERRED_PROVIDER_virtual/obmc-fan-mgmt = "packagegroup-accelsius-apps"
PREFERRED_PROVIDER_virtual/obmc-flash-mgmt = "packagegroup-accelsius-apps"
PREFERRED_PROVIDER_virtual/obmc-inventory-data ?= "${VIRTUAL-RUNTIME_skeleton_workbook}"
PREFERRED_PROVIDER_virtual/obmc-system-mgmt = "packagegroup-accelsius-apps"

#IMAGE_FEATURES:remove = "obmc-ikvm"

SERIAL_CONSOLES:accelsius = "115200;ttyS4"
```

## meta-accelsius/meta-rcu/conf/layer.conf
```bitbake
# We have a conf and classes directory, add to BBPATH
BBPATH .= ":${LAYERDIR}"

# We have recipes-* directories, add to BBFILES
BBFILES += "${LAYERDIR}/recipes-*/*/*.bb \
            ${LAYERDIR}/recipes-*/*/*.bbappend"

BBFILE_COLLECTIONS += "rcu"
BBFILE_PATTERN_rcu = "^${LAYERDIR}/"
LAYERSERIES_COMPAT_rcu = "kirkstone langdale"
```

## meta-accelsius/meta-rcu/conf/local.conf.sample
```bitbake
MACHINE ??= "rcu"
#DL_DIR ?= "/home/shambhu/AspeedBMC_Repo_WorkSpace/WorkSpaceV8.04/openbmc/build/rcu/downloads"
DISTRO ?= "openbmc-phosphor"
PACKAGE_CLASSES ?= "package_ipk"
SANITY_TESTED_DISTROS:append ?= " *"
EXTRA_IMAGE_FEATURES ?= "debug-tweaks"
USER_CLASSES ?= "buildstats"
PATCHRESOLVE = "noop"
BB_DISKMON_DIRS ??= "\
    STOPTASKS,${TMPDIR},1G,100K \
    STOPTASKS,${DL_DIR},1G,100K \
    STOPTASKS,${SSTATE_DIR},1G,100K \
    STOPTASKS,/tmp,100M,100K \
    HALT,${TMPDIR},100M,1K \
    HALT,${DL_DIR},100M,1K \
    HALT,${SSTATE_DIR},100M,1K \
    HALT,/tmp,10M,1K"
CONF_VERSION = "2"
INHERIT += "extrausers"
EXTRA_USERS_PARAMS = " \
  usermod -p '\$1\$UGMqyqdG\$FZiylVFmRRfl9Z0Ue8G7e/' root; \
  "

# Change time zone to local time from UTC for applying localtime
# in kernel build time.
TZ = '/etc/localtime'

require conf/machine/include/obmc-bsp-common.inc

# AST2600 Alternate Boot Record feature
#require conf/machine/include/ast-abr.inc

# Enable both of them if BMC flash model is Cypress S25Hxx and 2-bit ECC is enabled.
#require conf/machine/include/cypress-s25hx.inc
#require conf/machine/include/static-rwfs.inc

# Free Open Source Software (FOSS) Creation
# INHERIT += "archiver"
# ARCHIVER_MODE[src] = "original"
# ARCHIVER_MODE[recipe] = "1"
# COPYLEFT_LICENSE_INCLUDE = "*"

BB_NUMBER_THREADS = "2"
PARALLEL_MAKE = "-j 2"
```
